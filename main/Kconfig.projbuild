## main/Kconfig.projbuild
```kconfig
menu "Cyberfrog config"
	    orsource "$IDF_PATH/examples/common_components/env_caps/$IDF_TARGET/Kconfig.env_caps"

		config EFUSE_RSA_SIG
			bool "Use fast RSA signature (requires efuse)"
			default n

		config NFC_PASSWORD
			string "NFC password"
			default "12345678"
			help
				Password for NFC authentication

endmenu
```
